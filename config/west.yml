## config/west.yml
```yaml
manifest:
  remotes:
    - name: zmkfirmware
      url-base: https://github.com/zmkfirmware
    - name: englmaxi 
      url-base: https://github.com/englmaxi
  projects:
    - name: zephyr
      remote: zmkfirmware
      revision: 628a0d85e36938dddb6f0dfc6dc902de7359711c
      import:
        name-blocklist:
          - ci-tools
          - hal_altera
          - hal_cypress
          - hal_infineon
          - hal_microchip
          - hal_nxp
          - hal_openisa
          - hal_silabs
          - hal_xtensa
          - hal_st
          - hal_ti
          - loramac-node
          - mcuboot
          - mcumgr
          - net-tools
          - openthread
          - edtt
          - trusted-firmware-m
    - name: zmk
      remote: zmkfirmware
      revision: cef7af4408cc44c20fab93a0b2e20b3429d0a98e  # 
      import: app/west.yml
    - name: zmk-dongle-display
      remote: englmaxi
      revision: 9c84784c7a1c68cbd437288fa11ee7a572bdf320
  self:
    path: config
```
